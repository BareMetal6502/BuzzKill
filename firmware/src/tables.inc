/**********
*
* BuzzKill Sound Effects Board v1.0 for AVR16DD14 microcontroller
*
* Released under MIT License
*
* Copyright (c) 2025 Todd E. Stidham
*
* Permission is hereby granted, free of charge, to any person obtaining a copy
* of this software and associated documentation files (the "Software"), to deal
* in the Software without restriction, including without limitation the rights
* to use, copy, modify, merge, publish, distribute, sublicense, and/or sell
* copies of the Software, and to permit persons to whom the Software is
* furnished to do so, subject to the following conditions:
*
* The above copyright notice and this permission notice shall be included in all
* copies or substantial portions of the Software.
*
* THE SOFTWARE IS PROVIDED "AS IS", WITHOUT WARRANTY OF ANY KIND, EXPRESS OR
* IMPLIED, INCLUDING BUT NOT LIMITED TO THE WARRANTIES OF MERCHANTABILITY,
* FITNESS FOR A PARTICULAR PURPOSE AND NONINFRINGEMENT. IN NO EVENT SHALL THE
* AUTHORS OR COPYRIGHT HOLDERS BE LIABLE FOR ANY CLAIM, DAMAGES OR OTHER
* LIABILITY, WHETHER IN AN ACTION OF CONTRACT, TORT OR OTHERWISE, ARISING FROM,
* OUT OF OR IN CONNECTION WITH THE SOFTWARE OR THE USE OR OTHER DEALINGS IN THE
* SOFTWARE.
*
**********/

/**********
* Here we define the various data tables that need to be stored in flash
* We structure them as macros so that we can define them all together for convenience, but still place them individually as needed
**********/

/**********
* First are the tables which will be copied to ram during intialization, and accessed only from ram thereafter
* They don't need any specific alignment since efficient access (of the flash during init) is not a concern
* Thus they are "floating" tables that can be placed anywhere there is a reasonable space in flash memory
* Sticking them into otherwise unused gaps here and there allows us to squeeze everything into our tight memory footprint
**********/

.MACRO TABLE_FABMIDL
	.EQU fabmidl=PC
	.DB 0, 255, 255, 170, 255, 153, 85, 73, 255, 56, 204, 162, 170, 216, 36, 136, 255, 135, 28, 188
	.DB 102, 24, 209, 144, 85, 30, 236, 189, 146, 105, 68, 33, 255, 224, 195, 168, 142, 117, 94, 72
	.DB 51, 31, 12, 250, 232, 216, 200, 185, 170, 156, 143, 130, 118, 106, 94, 83, 73, 62, 52, 43
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	.DB 136, 135, 135, 134, 134, 133, 133, 132, 132, 131, 131, 130, 130, 129, 129, 128
.ENDMACRO

.MACRO TABLE_FABMIDH
	.EQU fabmidh=PC
	.DB 0, 127, 63, 42, 31, 25, 21, 18, 15, 14, 12, 11, 10, 9, 9, 8, 7, 7, 7, 6
	.DB 6, 6, 5, 5, 5, 5, 4, 4, 4, 4, 4, 4, 3, 3, 3, 3, 3, 3, 3, 3
	.DB 3, 3, 3, 2, 2, 2, 2, 2, 2, 2, 2, 2, 2, 2, 2, 2, 2, 2, 2, 2
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	.DB 0, 0, 0, 0, 0, 0, 0, 0, 0, 0, 0, 0, 0, 0, 0, 0
.ENDMACRO

.MACRO TABLE_FABEXPON
	.EQU fabexpon=PC
	.DB 0, 0, 0, 0, 0, 0, 0, 0, 0, 0, 179, 93, 21, 216, 164, 119, 80, 45, 14, 242
	.DB 217, 195, 174, 155, 138, 122, 108, 94, 82, 70, 59, 49, 40, 31, 22, 14, 7, 0, 249, 242
	.DB 236, 231, 225, 220, 215, 210, 205, 201, 197, 193, 189, 185, 182, 178, 175, 172, 169, 166, 163, 160
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	.DB 0, 0, 0, 0, 0, 0, 0, 0, 0, 0, 0, 0, 0, 0, 0, 0
.ENDMACRO

.MACRO TABLE_FABSTEP
	.EQU fabstep=PC
	.DB 0xff, 0xfe, 0xfc, 0xf8, 0xf0, 0xe0, 0xc0, 0x80
.ENDMACRO

.MACRO TABLE_FABDFLTS
	.EQU fabdflts=PC
	.DB 0, 0, 128, 0, 0, 0, 128, 0, 0, 0, 128, 0, 0, 0, 128, 0
	.DB 0, 0, 128, 0, 0, 0, 128, 0, 0, 0, 128, 0, 0, 0, 128, 0
	.DB 0, 0, 127, 240, 0, 0, 127, 240, 0, 0, 127, 240, 0, 0, 127, 240
	.DB 240, 0, 0, 0, 0, 0, 0, 0, 0, 0, 0, 0
.ENDMACRO

.MACRO TABLE_FABSPCHDEF
	.EQU fabspchdef=PC
	.DB 162, 55, 128, 182, 128, 199, 128, 255, 128, 0, 0, 0, 0, 0, 0, 0, 0, 0, 0, 0
	.DB 0, 0, 0, 0, 0, 0, 0, 0, 0, 0, 0, 0, 0, 0, 0, 0, 0, 0
.ENDMACRO


/**********
* Next are the tables that are never copied or moved, and accessed directly from their initial locations in flash
* They need to be accessed as efficiently as possible, so they are aligned on page boundaries to eliminate index offsets
* They waste some space and have limited placement flexibility, but don't use up any precious ram
**********/

.MACRO TABLE_SINE
	ALIGN 128
	.EQU tabsin=PC
	.DB 128, 131, 134, 137, 140, 144, 147, 150, 153, 156, 159, 162, 165, 168, 171, 174, 177, 179, 182, 185
	.DB 188, 191, 193, 196, 199, 201, 204, 206, 209, 211, 213, 216, 218, 220, 222, 224, 226, 228, 230, 232
	.DB 234, 235, 237, 239, 240, 241, 243, 244, 245, 246, 248, 249, 250, 250, 251, 252, 253, 253, 254, 254
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	.DB 79, 82, 85, 88, 91, 94, 97, 100, 103, 106, 109, 112, 116, 119, 122, 125
.ENDMACRO

.MACRO TABLE_PHONLEN
	ALIGN 128
	.EQU tabplen=PC
	.DB 12, 12, 12, 8, 12, 8, 12, 8, 8, 11, 8, 8, 8, 12, 11, 6, 9, 10, 8, 5
	.DB 10, 10, 8, 7, 6, 6, 8, 6, 7, 7, 8, 4, 6, 7, 10, 6, 9, 8, 9, 6
	.DB 8, 7, 6, 6, 4, 5, 8, 6, 6, 6, 8, 6, 2, 6, 12, 24, 1, 1, 2, 1
	.DB 2, 1, 1, 1, 3, 6, 4, 2, 2, 1, 2, 2, 4, 2

.ENDMACRO
.MACRO TABLE_FORMANTS
	ALIGN 128
	.EQU tabform1=PC
	.DB 138, 127, 199, 127, 138, 111, 76, 95, 199, 127, 76, 95, 153, 127, 76, 95, 183, 127, 199, 127
	.DB 76, 95, 138, 111, 76, 95, 153, 127, 138, 79, 168, 127, 92, 95, 122, 127, 107, 95, 153, 79
	.DB 46, 0, 46, 0, 46, 0, 61, 71, 69, 71, 76, 71, 46, 0, 76, 71, 46, 79, 46, 47
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	.DB 46, 0, 46, 0, 76, 0, 46, 0
	ALIGN 128
	.EQU tabform2=PC
	.DB 69, 79, 97, 95, 166, 111, 194, 55, 88, 95, 194, 55, 69, 79, 194, 55, 143, 111, 92, 95
	.DB 194, 55, 152, 95, 194, 55, 69, 79, 111, 71, 101, 79, 78, 39, 83, 71, 166, 71, 101, 47
	.DB 168, 0, 182, 0, 60, 0, 92, 23, 118, 23, 152, 31, 152, 0, 108, 23, 106, 23, 125, 47
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	.DB 60, 0, 60, 0, 251, 0, 254, 0
	ALIGN 128
	.EQU tabform3=PC
	.DB 185, 0, 185, 15, 190, 47, 232, 39, 185, 15, 232, 39, 185, 0, 232, 39, 185, 39, 188, 15
	.DB 232, 39, 192, 39, 232, 39, 185, 0, 131, 31, 183, 15, 173, 0, 173, 15, 196, 39, 188, 0
	.DB 209, 0, 223, 0, 171, 0, 160, 0, 196, 0, 217, 15, 255, 0, 196, 0, 171, 0, 255, 0
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	.DB 171, 0, 0, 0, 236, 0, 232, 0
	ALIGN 128
	.EQU tabform4=PC
	.DB 0, 0, 0, 0, 0, 0, 0, 0, 0, 0, 0, 0, 0, 0, 0, 0, 0, 0, 0, 0
	.DB 0, 0, 0, 0, 0, 0, 0, 0, 0, 0, 0, 0, 0, 0, 0, 0, 0, 0, 0, 0
	.DB 255, 55, 255, 103, 119, 39, 255, 23, 255, 31, 255, 55, 187, 39, 187, 23, 0, 0, 0, 0
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	.DB 0, 0, 0, 0, 0, 0, 0, 0
.ENDMACRO
